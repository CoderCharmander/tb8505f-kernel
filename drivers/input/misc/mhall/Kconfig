## drivers/input/misc/mhall/Kconfig
```kconfig
config CONFIG_INPUT_MHALL
	bool "CONFIG_INPUT_MHALL"
	 

source "drivers/input/misc/mhall/bu52013hfv/Kconfig"
```

## drivers/input/misc/mhall/bu52013hfv/Kconfig
```kconfig
config INPUT_MHALL
	bool "INPUT_MHALL for MediaTek package"
	default n
	help
	  It support different mall sensor.
          If this option is set,
	  it will support
          INPUT_MHALL HALL_SENSOR.
```

## drivers/input/misc/sx9328/Kconfig
```kconfig
config INPUT_SAR_SX9328
	tristate "SX9328_SAR_sensor"
	depends on I2C
	default n
	help
	 Say Y to enable the SAR detection application, if N here not to use the
	 this SAR sensor
```
